/*                              36 KEY MATRIX / LAYOUT MAPPING

  ╭────────────────────────┬────────────────────────╮ ╭─────────────────────────┬─────────────────────────╮
  │  0   1   2   3   4     │      5   6   7   8   9 │ │ LT4 LT3 LT2 LT1 LT0     │     RT0 RT1 RT2 RT3 RT4 │
  │ 10  11  12  13  14     │     15  16  17  18  19 │ │ LM4 LM3 LM2 LM1 LM0     │     RM0 RM1 RM2 RM3 RM4 │
  │ 20  21  22  23  24     │     25  26  27  28  29 │ │ LB4 LB3 LB2 LB1 LB0     │     RB0 RB1 RB2 RB3 RB4 │
  ╰───────────╮ 30  31  32 │ 33  34  35 ╭───────────╯ ╰───────────╮ LH2 LH1 LH0 │ RH0 RH1 RH2 ╭───────────╯
              ╰────────────┴────────────╯                         ╰─────────────┴─────────────╯             */
#include "mouse.dtsi"
#define TERM 50

#define COMBO(NAME, TIMEOUT, KEYS, BINDINGS, LAYERS) \
    combo_##NAME { \
        timeout-ms = <TIMEOUT>; \
        key-positions = <KEYS>; \
        bindings = <BINDINGS>; \
        layers = <LAYERS>; \
    };
/ {
  combos {
    compatible = "zmk,combos";

    // macro dot spc
    COMBO(dot_spc, TERM, LH1 RH1, &dot_spc, BASE GAME)

    // (
    COMBO(LPAR, TERM, RT1 RT2, &kp LPAR, BASE GAME)

    // )
    COMBO(RPAR, TERM, RT2 RT3, &kp RPAR, BASE GAME)

    // <
    COMBO(LT, TERM, RB1 RB2, &kp LT, BASE GAME)

    // >
    COMBO(GT, TERM, RB2 RB3, &kp GT, BASE GAME)

    // [
    COMBO(LBKT, TERM, LT3 LT2, &kp LBKT, BASE GAME)

    // ]
    COMBO(RBKT, TERM, LT2 LT1, &kp RBKT, BASE GAME)

    // {
    COMBO(LBRC, TERM, LB3 LB2, &kp LBRC, BASE GAME)

    // }
    COMBO(RBRC, TERM, LB2 LB1, &kp RBRC, BASE GAME)

    // @
    COMBO(AT, TERM, LT3 LM3, &kp AT, BASE GAME)

    // #
    COMBO(HASH, TERM, LT2 LM2, &kp HASH, BASE GAME)

    // $
    COMBO(DOLLAR, TERM, LT1 LM1, &kp DOLLAR, BASE GAME)

    // %
    COMBO(PERCENT, TERM, LT0 LM0, &kp PERCENT, BASE GAME)

    // ^
    COMBO(CARET, TERM, RT0 RM0, &kp CARET, BASE GAME)

    // +
    COMBO(PLUS, TERM, RT1 RM1, &kp PLUS, BASE GAME)

    // *
    COMBO(ASTERISK, TERM, RT2 RM2, &kp STAR, BASE GAME)

    // &
    COMBO(AMP, TERM, RT3 RM3, &kp AMPS, BASE GAME)

    // `
    COMBO(GRAVE, TERM, LM3 LB3, &kp GRAVE, BASE GAME)

    COMBO(BSLH, TERM, LM2 LB2, &kp BSLH, BASE GAME)

    // =
    COMBO(EQUAL, TERM, LM1 LB1, &kp EQUAL, BASE GAME)

    // ~
    COMBO(TILDE, TERM, LM0 LB0, &kp TILDE, BASE GAME)

    // _
    COMBO(UNDER, TERM, RM0 RB0, &kp UNDER, BASE GAME)

    // -
    COMBO(MINUS, TERM, RM1 RB1, &kp MINUS, BASE GAME)

    // /
    COMBO(FSLH, TERM, RM2 RB2, &kp FSLH, BASE GAME)

    // |
    COMBO(PIPE, TERM, RM3 RB3, &kp PIPE, BASE GAME)

    // toggle game mode
    COMBO(TOG_GAME, TERM, LT4 LM4 LB4, &tog GAME, BASE GAME)

    // mouse
    COMBO(LCLK, TERM, RM1 RM2, &mkp LCLK, BASE GAME)
    COMBO(RCLK, TERM, RM2 RM3, &mkp RCLK, BASE GAME)
    COMBO(MCLK, TERM, RM1 RM3, &mkp MCLK, BASE GAME)
  };
};
